## Kconfig
```kconfig
config RAW_HID
    bool "Enable Raw HID"
    depends on !ZMK_SPLIT || ZMK_SPLIT_ROLE_CENTRAL || ZMK_SPLIT_ROLE_PERIPHERAL
    imply USB_DEVICE_HID

config RAW_HID_USAGE_PAGE
    hex "Raw HID Usage Page"
    default 0xFF60

config RAW_HID_USAGE
    hex "Raw HID Usage"
    default 0x61

config RAW_HID_REPORT_SIZE
    int "Raw HID Report Size"
    default 32

config RAW_HID_DEVICE
    string "Raw HID Device"
    default HID_1

config RAW_HID_FORWARD_TO_PERIPHERAL
    bool "Relay Raw HID reports to split peripheral over output relay"
    depends on RAW_HID && ZMK_SPLIT && ZMK_SPLT_PERIPHERAL_OUTPUT_RELAY
    default y
    help
      When enabled, Raw HID reports received on the central half are forwarded to
      connected peripherals via the split peripheral output relay channel. The
      peripheral can then surface the data (for example on a display).

config RAW_HID_SPLIT_RELAY_CHANNEL
    int "Relay channel used for Raw HID forwarding"
    depends on RAW_HID_FORWARD_TO_PERIPHERAL
    range 0 255
    default 1
    help
      Relay channel identifier used when sending Raw HID payloads to peripherals.
      The same channel must be handled on the peripheral side to consume the
      forwarded data.
```

## config/west.yml
```yaml
manifest:
  remotes:
    - name: zmkfirmware
      url-base: https://github.com/zmkfirmware
    - name: zzeneg
      url-base: https://github.com/zzeneg
    - name: oleksandrmaslov
      url-base: https://github.com/oleksandrmaslov
    - name: badjeff
      url-base: https://github.com/badjeff
  projects:
    - name: zmk
      remote: zmkfirmware
      revision: main
      import: app/west.yml
    - name: zmk-split-peripheral-output-relay
      remote: oleksandrmaslov
      revision: peripheral
  self:
    path: config
```
